## pkg/doomgeneric/Kconfig
```kconfig
# Copyright (c) 2021 Kaspar Schleiser <kaspar@schleiser.de>
#
# This file is subject to the terms and conditions of the GNU Lesser
# General Public License v2.1. See the file LICENSE in the top level
# directory for more details.
#

config PACKAGE_DOOMGENERIC
    bool "DOOM game"
    depends on TEST_KCONFIG
```

## pkg/lv_drivers/Kconfig
```kconfig
# Copyright (c) 2021 Inria
#
# This file is subject to the terms and conditions of the GNU Lesser
# General Public License v2.1. See the file LICENSE in the top level
# directory for more details.
#

if TEST_KCONFIG

menuconfig PACKAGE_LV_DRIVERS
    bool "LVGL Drivers Package"
    depends on PACKAGE_LVGL

if PACKAGE_LVGL

config MODULE_LV_DRIVERS_DISPLAY_SDL
    bool "SDL driver"
    depends on HAS_ARCH_NATIVE
    select MODULE_LV_DRIVERS_SDL

config MODULE_LV_DRIVERS_SDL
    bool "SDL driver Adaptation Code"
    depends on HAS_ARCH_NATIVE
    select MODULE_LV_DRIVERS_MOUSE

config MODULE_LV_DRIVERS_INDEV_MOUSE
    bool "Mouse Driver"
    depends on HAS_ARCH_NATIVE

config MODULE_LV_DRIVERS_MOUSE
    bool "Mouse Driver Adaptation Code"
    depends on HAS_ARCH_NATIVE

config HAVE_DISPLAY_SDL
    bool
    select MODULE_LV_DRIVERS_DISPLAY_SDL if MODULE_DISP_DEV
    help
        Indicates SDL is present

config HAVE_INDEV_MOUSE
    bool
    select MODULE_LV_DRIVERS_INDEV_MOUSE if MODULE_TOUCH_DEV
    help
        Indicates a mouse input device is present

endif # PACKAGE_LV_DRIVERS

endif # TEST_KCONFIG
```
